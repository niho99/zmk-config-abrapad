## config/boards/shields/abrapad/Kconfig.defconfig
```kconfig
if SHIELD_ABRAPAD

# Name must be less than 16 characters long!
config ZMK_KEYBOARD_NAME
    default "AbraPad"

endif
```

## config/boards/shields/abrapad/Kconfig.shield
```kconfig
# No whitespace after the comma or in your keyboard name!
config SHIELD_ABRAPAD
    def_bool $(shields_list_contains,AbraPad)
```
